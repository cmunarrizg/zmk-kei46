#include <behaviors.dtsi>
#include <dt-bindings/zmk/keys.h>
#include <dt-bindings/zmk/bt.h>
#include <dt-bindings/zmk/outputs.h>

&mt {
  tapping-term-ms = <200>;
};

#define COMBO(NAME, BINDINGS, KEYPOS) \
  combo_##NAME { \
    timeout-ms = <50>; \
    bindings = <BINDINGS>; \
    key-positions = <KEYPOS>; \
    layers = <0>; \
  };



/ {
    behaviors {
          hm: homerow_mods {
            compatible = "zmk,behavior-hold-tap";
            label = "HOMEROW_MODS";
            #binding-cells = <2>;
            tapping-term-ms = <200>;
            quick-tap-ms = <100>;
            flavor = "tap-preferred";
            bindings = <&kp>, <&kp>;
          };

          td_caps: tap_dance_caps {
            compatible = "zmk,behavior-tap-dance";
            label = "TAP_DANCE_CAPS";
            #binding-cells = <0>;
            tapping-term-ms = <200>;
            bindings = <&kp G>, <&kp CAPS>;
          };
    };

    combos {
          compatible = "zmk,combos";
  
          COMBO(esc_combo, &kp ESC, 1 2)
          COMBO(lgui_combo, &kp LGUI, 29 30)
        };

    keymap {
        compatible = "zmk,keymap";

        base {
            // ┌───────────────────────────────────┐

            label = "BASE";

            // └───────────────────────────────────┘

            bindings = <
&kp ESCAPE  &kp Q  &kp W  &kp E  &kp R  &kp T  &kp Y  &kp U  &kp I  &kp O  &kp P  &soft_off  &kp TAB  &kp A  &hm LEFT_ALT S  &hm LEFT_SHIFT D  &hm LCTRL F  &td_caps  &kp H  &hm LEFT_CONTROL J  &hm RSHFT K  &kp L  &hm RIGHT_ALT SEMICOLON  &none  &kp LSHFT  &kp Z  &kp X  &kp C  &kp V  &kp B  &kp N  &kp M  &kp COMMA  &kp PERIOD  &kp SLASH  &kp RSHFT  &none  &none  &none  &kp DEL  &lt 1 BACKSPACE  &lt 2 SPACE  &kp TAB  &none  &none  &none  &kp C_MUTE
            >;

            sensor-bindings = <&inc_dec_kp C_VOL_UP C_VOL_DN>;
        };

        symbols {
            bindings = <
&none  &kp PRINTSCREEN  &none  &kp GRAVE  &kp LS(GRAVE)  &kp LEFT_BRACKET  &kp RIGHT_BRACKET  &kp HOME  &kp UP_ARROW  &kp END  &kp PAGE_UP  &none  &none  &none  &none  &kp SQT  &kp LS(SQT)  &kp LS(LEFT_BRACKET)  &kp LS(RIGHT_BRACKET)  &kp LEFT  &kp DOWN_ARROW  &kp RIGHT_ARROW  &kp PAGE_DOWN  &none  &none  &none  &none  &kp LC(C)  &kp LC(V)  &kp BACKSLASH  &kp LS(BACKSLASH)  &kp EQUAL  &kp LS(EQUAL)  &kp MINUS  &kp LS(MINUS)  &none  &none  &none  &none  &none  &none  &lt 3 SPACE  &kp DEL  &none  &none  &none  &none
            >;

	    sensor-bindings = <&inc_dec_kp C_VOL_UP C_VOL_DN>;
        };

        numbers {
            bindings = <
&none  &kp LS(NUMBER_1)  &kp LS(NUMBER_2)  &kp LS(NUMBER_3)  &kp LS(NUMBER_4)  &kp LS(N5)  &kp LS(NUMBER_6)  &kp LS(N7)  &kp LS(N8)  &kp LS(N9)  &kp LS(N0)  &none  &none  &kp NUMBER_1  &kp NUMBER_2  &kp NUMBER_3  &kp NUMBER_4  &kp N5  &kp NUMBER_6  &kp N7  &kp N8  &kp N9  &kp N0  &none  &kp F11  &kp F1  &kp F2  &kp F3  &kp F4  &kp F5  &kp F6  &kp F7  &kp F8  &kp F9  &kp F10  &kp F12  &none  &none  &none  &kp BACKSPACE  &lt 3 ENTER  &none  &none  &none  &none  &none  &none
            >;

	    sensor-bindings = <&inc_dec_kp C_VOL_UP C_VOL_DN>;
        };

        adjust {
            bindings = <
&bt BT_CLR  &none  &none  &none  &none  &none  &none  &none  &none  &none  &none  &none  &none  &bt BT_SEL 0  &bt BT_SEL 1  &bt BT_SEL 2  &bt BT_SEL 3  &bt BT_SEL 4  &none  &none  &none  &none  &none  &none  &none  &kp LG(L)  &none  &none  &none  &none  &none  &none  &none  &none  &none  &none  &none  &none  &none  &none  &none  &none  &none  &sys_reset  &bootloader  &none  &none
            >;

	    sensor-bindings = <&inc_dec_kp C_VOL_UP C_VOL_DN>;
        };
    };
};
