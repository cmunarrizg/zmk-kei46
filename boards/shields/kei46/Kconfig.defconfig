## boards/shields/kei46/Kconfig.defconfig
```kconfig
# Copyright (c) 2022 The ZMK Contributors
# SPDX-License-Identifier: MIT

if SHIELD_KEI46

config ZMK_KEYBOARD_NAME
    default "Kei46"

endif # SHIELD_KEI46
```

## boards/shields/kei46/Kconfig.shield
```kconfig
# Copyright (c) 2022 The ZMK Contributors
# SPDX-License-Identifier: MIT

config SHIELD_KEI46
    def_bool $(shields_list_contains,kei46)
```
